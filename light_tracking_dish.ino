/*
:Author: Piyush Raut
:Email: piyush2947@gmail.com
:Date: 12/04/2018
:Revision: version#1
:License: Public Domain
*/

#include <AFMotor.h>
#include <Servo.h>

Servo servo_hor, servo_ver; //servo motors controlling horizontal and vertical axis

int servo_hor_position = 90;
int servo_ver_position = 90;

int error = 10;

int Light0 (int RawADC1)
{
  double Vout1 = RawADC1*0.0048828125;
  int lux1 = (2500/Vout1 - 500)/10;
  return lux1;
}

int Light1 (int RawADC2)
{
  double Vout2 = RawADC2*0.0048828125;
  int lux2 = (2500/Vout2 - 500)/10;
  return lux2;
}

int Light2 (int RawADC3)
{
  double Vout3 = RawADC3*0.0048828125;
  int lux3 = (2500/Vout3 - 500)/10;
  return lux3;
}

int Light3 (int RawADC4)
{
  double Vout4 = RawADC4*0.0048828125;
  int lux4 = (2500/Vout4 - 500)/10;
  return lux4;
}

void setup() {
  servo_ver.attach(9); //defining servo signal pins
  servo_hor.attach(10);
  
  servo_ver.write(servo_ver_position);
  servo_hor.write(servo_hor_position);
  
  Serial.begin(9600);
}

void loop() {
  servo_hor.write(servo_hor_position);
  servo_ver.write(servo_ver_position);
  
  //For Horizontal Rotation
  int diff0 = abs(int(Light0(analogRead(A0))) - int(Light1(analogRead(A1))));
  int diff1 = abs(int(Light1(analogRead(A1))) - int(Light0(analogRead(A0))));
  
  if((diff0 >= error) || (diff1 >= error))
  {
    if((int(Light1(analogRead(A1))) > int(Light0(analogRead(A0)))) && servo_hor_position >= 0)
    {
      servo_hor_position = servo_hor_position - 10;
    }
    
    if((int(Light1(analogRead(A1))) < int(Light0(analogRead(A0)))) && servo_hor_position <= 180)
    {
      servo_hor_position = servo_hor_position + 10;
    }
  }
  
  
  //For Vertical Rotation
  int diff2 = abs(int(Light2(analogRead(A2))) - int(Light3(analogRead(A3))));
  int diff3 = abs(int(Light3(analogRead(A3))) - int(Light2(analogRead(A2))));
  
  if((diff2 >= error) || (diff3 >= error)){
    if((int(Light2(analogRead(A2))) > int(Light3(analogRead(A3)))) && servo_ver_position >= 0)
    {
      servo_ver_position = servo_ver_position - 10;
    }
    
    if((int(Light2(analogRead(A2))) < int(Light3(analogRead(A3)))) && servo_ver_position <= 180)
    {
      servo_ver_position = servo_ver_position + 10;
    }
  }
  
  servo_hor.write(servo_hor_position);
  servo_ver.write(servo_ver_position);
  
  Serial.print("Light Intensity A0:");
  Serial.print(int(Light0(analogRead(A0))));
  Serial.println(" Lux");
  
  Serial.print("Light Intensity A1:");
  Serial.print(int(Light1(analogRead(A1))));
  Serial.println(" Lux");
  
  Serial.print("Light Intensity A2:");
  Serial.print(int(Light2(analogRead(A2))));
  Serial.println(" Lux");
  
  Serial.print("Light Intensity A3:");
  Serial.print(int(Light3(analogRead(A3))));
  Serial.println(" Lux\n\n");
  
  delay(100);  
}
